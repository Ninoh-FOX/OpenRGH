## defconfig
```kconfig
BR2_mipsel=y
BR2_mips_32r2=y
# BR2_MIPS_SOFT_FLOAT is not set
BR2_OPTIMIZE_2=y
BR2_TOOLCHAIN_BUILDROOT_VENDOR="gcw0"
BR2_KERNEL_HEADERS_3_12=y
BR2_UCLIBC_CONFIG="board/opendingux/gcw0/uclibc.config"
BR2_TOOLCHAIN_BUILDROOT_LARGEFILE=y
BR2_TOOLCHAIN_BUILDROOT_INET_IPV6=y
BR2_TOOLCHAIN_BUILDROOT_WCHAR=y
BR2_PTHREAD_DEBUG=y
BR2_BINUTILS_EXTRA_CONFIG_OPTIONS="--enable-lto"
BR2_GCC_VERSION_4_9_X=y
BR2_EXTRA_GCC_CONFIG_OPTIONS="--enable-lto"
BR2_TOOLCHAIN_BUILDROOT_CXX=y
BR2_PACKAGE_HOST_GDB=y
BR2_GDB_VERSION_7_7=y
BR2_TARGET_GENERIC_HOSTNAME="opendingux"
BR2_TARGET_GENERIC_ISSUE="Welcome to OpenDingux"
BR2_ROOTFS_DEVICE_CREATION_DYNAMIC_EUDEV=y
BR2_ROOTFS_SKELETON_CUSTOM=y
BR2_ROOTFS_SKELETON_CUSTOM_PATH="board/opendingux/gcw0/target_skeleton"
BR2_TARGET_TZ_INFO=y
BR2_ROOTFS_POST_BUILD_SCRIPT="board/opendingux/gcw0/post-build-script.sh"
BR2_LINUX_KERNEL=y
BR2_LINUX_KERNEL_CUSTOM_GIT=y
BR2_LINUX_KERNEL_CUSTOM_REPO_URL="https://github.com/tonyjih/RG350_linux"
BR2_LINUX_KERNEL_CUSTOM_REPO_VERSION="master"
BR2_LINUX_KERNEL_USE_CUSTOM_CONFIG=y
BR2_LINUX_KERNEL_CUSTOM_CONFIG_FILE="board/kernel/rg350/rg350_linux.config"
BR2_LINUX_KERNEL_VMLINUZ_BIN=y
BR2_PACKAGE_BUSYBOX_CONFIG="board/opendingux/busybox-1.20.x.config"
BR2_PACKAGE_BUSYBOX_SHOW_OTHERS=y
BR2_PACKAGE_ALSA_UTILS=y
BR2_PACKAGE_ALSA_UTILS_AMIDI=y
BR2_PACKAGE_ALSA_UTILS_AMIXER=y
BR2_PACKAGE_ALSA_UTILS_APLAY=y
BR2_PACKAGE_ALSA_UTILS_ACONNECT=y
BR2_PACKAGE_ALSA_UTILS_APLAYMIDI=y
BR2_PACKAGE_ALSA_UTILS_ARECORDMIDI=y
BR2_PACKAGE_ALSA_UTILS_ASEQDUMP=y
BR2_PACKAGE_ALSA_UTILS_ASEQNET=y
BR2_PACKAGE_ALSA_VOLUME=y
BR2_PACKAGE_FLAC=y
BR2_PACKAGE_MODPLUGTOOLS=y
BR2_PACKAGE_OPENAL_SOFT=y
BR2_PACKAGE_P7ZIP=y
BR2_PACKAGE_UNRAR=y
# BR2_PACKAGE_UNRAR_SMP is not set
BR2_PACKAGE_DMALLOC=y
BR2_PACKAGE_DSTAT=y
BR2_PACKAGE_GDB=y
BR2_PACKAGE_GDB_SERVER=y
BR2_PACKAGE_GDB_DEBUGGER=y
BR2_PACKAGE_MEMSTAT=y
BR2_PACKAGE_OPROFILE=y
BR2_PACKAGE_STRACE=y
BR2_PACKAGE_STRESS=y
BR2_PACKAGE_BINUTILS_TARGET=y
BR2_PACKAGE_SSTRIP=y
BR2_PACKAGE_DOSFSTOOLS=y
BR2_PACKAGE_DOSFSTOOLS_FSCK_FAT=y
BR2_PACKAGE_E2FSPROGS=y
# BR2_PACKAGE_E2FSPROGS_CHATTR is not set
# BR2_PACKAGE_E2FSPROGS_DUMPE2FS is not set
# BR2_PACKAGE_E2FSPROGS_E2FREEFRAG is not set
# BR2_PACKAGE_E2FSPROGS_E2UNDO is not set
# BR2_PACKAGE_E2FSPROGS_FILEFRAG is not set
# BR2_PACKAGE_E2FSPROGS_FINDFS is not set
# BR2_PACKAGE_E2FSPROGS_FSCK is not set
# BR2_PACKAGE_E2FSPROGS_LOGSAVE is not set
# BR2_PACKAGE_E2FSPROGS_LSATTR is not set
# BR2_PACKAGE_E2FSPROGS_MKLOSTFOUND is not set
BR2_PACKAGE_E2FSPROGS_RESIZE2FS=y
# BR2_PACKAGE_E2FSPROGS_UUIDGEN is not set
BR2_PACKAGE_EXFAT=y
BR2_PACKAGE_NTFS_3G=y
BR2_PACKAGE_O2XIV=y
BR2_PACKAGE_ALLEGRO=y
BR2_PACKAGE_BENNUGD=y
BR2_PACKAGE_FBGRAB=y
BR2_PACKAGE_LOVE2D=y
BR2_PACKAGE_SDL_GFX=y
BR2_PACKAGE_SDL_IMAGE_GIF=y
BR2_PACKAGE_SDL_IMAGE_TARGA=y
BR2_PACKAGE_SDL_IMAGE_XPM=y
BR2_PACKAGE_SDL_NET=y
BR2_PACKAGE_SDL_SOUND=y
BR2_PACKAGE_SDL2_IMAGE=y
BR2_PACKAGE_SDL2_IMAGE_GIF=y
BR2_PACKAGE_SDL2_IMAGE_JPEG=y
BR2_PACKAGE_SDL2_IMAGE_PNG=y
BR2_PACKAGE_SDL2_IMAGE_XPM=y
BR2_PACKAGE_SDL2_MIXER=y
BR2_PACKAGE_SDL2_NET=y
BR2_PACKAGE_SDL2_TTF=y
BR2_PACKAGE_TIMIDITY_INSTRUMENTS=y
BR2_PACKAGE_UNLOCKVT=y
BR2_PACKAGE_APITRACE=y
# BR2_PACKAGE_DEJAVU_SERIF is not set
# BR2_PACKAGE_DEJAVU_SERIF_CONDENSED is not set
BR2_PACKAGE_PCSX4ALL=y
BR2_PACKAGE_PCSX4ALL_PLATFORM="gcw0"
BR2_PACKAGE_LINUX_FIRMWARE=y
BR2_PACKAGE_LINUX_FIRMWARE_RTL_81XX=y
BR2_PACKAGE_EVTEST=y
BR2_PACKAGE_FMTOOLS=y
BR2_PACKAGE_I2C_TOOLS=y
BR2_PACKAGE_LINUX_CONSOLE_TOOLS=y
BR2_PACKAGE_LINUX_CONSOLE_TOOLS_JOY=y
BR2_PACKAGE_LINUX_CONSOLE_TOOLS_FF=y
BR2_PACKAGE_LOWPOWD=y
BR2_PACKAGE_PWSWD=y
BR2_PACKAGE_PWSWD_PLATFORM="gcw0"
BR2_PACKAGE_LIBSHAKE=y
BR2_PACKAGE_LIBSHAKE_PLATFORM="rg-350"
BR2_PACKAGE_LIBSHAKE2=y
BR2_PACKAGE_LIBSHAKE2_PLATFORM="rg-350"
BR2_PACKAGE_JAMVM=y
BR2_PACKAGE_LUAJIT=y
BR2_PACKAGE_NODEJS=y
BR2_PACKAGE_PYTHON_CURSES=y
BR2_PACKAGE_PYTHON_PYEXPAT=y
BR2_PACKAGE_PYTHON_READLINE=y
# BR2_PACKAGE_PYTHON_UNICODEDATA is not set
BR2_PACKAGE_PYTHON_SQLITE=y
BR2_PACKAGE_PYTHON_ZLIB=y
BR2_PACKAGE_PYTHON_PYGAME=y
BR2_PACKAGE_PYTHON_PYGAME_IMAGE=y
BR2_PACKAGE_PYTHON_PYGAME_MIXER_MUSIC=y
# BR2_PACKAGE_ALSA_LIB_ALISP is not set
# BR2_PACKAGE_ALSA_LIB_OLD_SYMBOLS is not set
BR2_PACKAGE_FLUIDSYNTH=y
BR2_PACKAGE_LIBAO=y
BR2_PACKAGE_LIBSNDFILE=y
BR2_PACKAGE_SPEEX=y
BR2_PACKAGE_TAGLIB=y
BR2_PACKAGE_TREMOR=y
BR2_PACKAGE_PHYSFS=y
BR2_PACKAGE_LIBCONFUSE=y
BR2_PACKAGE_LIBOPK=y
BR2_PACKAGE_LIBSYSFS=y
BR2_PACKAGE_ETNA_VIV=y
BR2_PACKAGE_ETNA_VIV_ABIV4=y
BR2_PACKAGE_LIBUNGIF=y
BR2_PACKAGE_MESA3D_ETNA_VIV=y
BR2_PACKAGE_LIBAIO=y
BR2_PACKAGE_TSLIB=y
BR2_PACKAGE_LIBTHEORA=y
BR2_PACKAGE_BOOST=y
BR2_PACKAGE_BOOST_STATIC=y
BR2_PACKAGE_BOOST_CHRONO=y
BR2_PACKAGE_BOOST_DATE_TIME=y
BR2_PACKAGE_BOOST_EXCEPTION=y
BR2_PACKAGE_BOOST_FILESYSTEM=y
BR2_PACKAGE_BOOST_GRAPH=y
BR2_PACKAGE_BOOST_IOSTREAMS=y
BR2_PACKAGE_BOOST_LOCALE=y
BR2_PACKAGE_BOOST_MATH=y
BR2_PACKAGE_BOOST_PROGRAM_OPTIONS=y
BR2_PACKAGE_BOOST_RANDOM=y
BR2_PACKAGE_BOOST_REGEX=y
BR2_PACKAGE_BOOST_SERIALIZATION=y
BR2_PACKAGE_BOOST_SIGNALS=y
BR2_PACKAGE_BOOST_SYSTEM=y
BR2_PACKAGE_BOOST_THREAD=y
BR2_PACKAGE_BOOST_TIMER=y
BR2_PACKAGE_GLM=y
BR2_PACKAGE_LIBXDGMIME=y
BR2_PACKAGE_GMENU2X=y
BR2_PACKAGE_GMENU2X_PLATFORM="gcw0"
BR2_PACKAGE_ESOTERIC=y
BR2_PACKAGE_ESOTERIC_PLATFORM="rg-350"
# BR2_PACKAGE_GMENUNX is not set
# BR2_PACKAGE_GMENUNX_PLATFORM it not set
BR2_PACKAGE_PYCLOCK=y
BR2_PACKAGE_AVAHI=y
BR2_PACKAGE_AVAHI_DAEMON=y
BR2_PACKAGE_BWM_NG=y
BR2_PACKAGE_DHCPDUMP=y
BR2_PACKAGE_DROPBEAR=y
BR2_PACKAGE_DROPBEAR_DISABLE_REVERSEDNS=y
# BR2_PACKAGE_DROPBEAR_SMALL is not set
BR2_PACKAGE_HOSTAPD=y
BR2_PACKAGE_HOSTAPD_EAP=y
BR2_PACKAGE_HOSTAPD_WPS=y
BR2_PACKAGE_IW=y
BR2_PACKAGE_NETCAT=y
BR2_PACKAGE_NTP=y
BR2_PACKAGE_NTP_NTPDATE=y
BR2_PACKAGE_NTP_NTPDC=y
BR2_PACKAGE_NTP_NTPQ=y
BR2_PACKAGE_NTP_TICKADJ=y
BR2_PACKAGE_OD_NETWORK_CONFIG=y
BR2_PACKAGE_OPENSSH=y
BR2_PACKAGE_RSYNC=y
BR2_PACKAGE_TCPDUMP=y
BR2_PACKAGE_USHARE=y
BR2_PACKAGE_VSFTPD=y
BR2_PACKAGE_WGET=y
BR2_PACKAGE_WIRELESS_TOOLS=y
BR2_PACKAGE_WPA_SUPPLICANT=y
BR2_PACKAGE_WPA_SUPPLICANT_AP_SUPPORT=y
BR2_PACKAGE_WPA_SUPPLICANT_WPS=y
BR2_PACKAGE_WPA_SUPPLICANT_CLI=y
BR2_PACKAGE_WPA_SUPPLICANT_PASSPHRASE=y
BR2_PACKAGE_XINETD=y
BR2_PACKAGE_BAR=y
BR2_PACKAGE_DIALOG=y
BR2_PACKAGE_FILE=y
BR2_PACKAGE_LOCKFILE_PROGS=y
BR2_PACKAGE_SCREEN=y
BR2_PACKAGE_DINGUX_COMMANDER=y
BR2_PACKAGE_HTOP=y
BR2_PACKAGE_KMOD_TOOLS=y
BR2_PACKAGE_UTIL_LINUX_BINARIES=y
BR2_PACKAGE_UTIL_LINUX_PARTX=y
BR2_PACKAGE_NANO=y
BR2_TARGET_ROOTFS_SQUASHFS=y
# BR2_TARGET_ROOTFS_TAR is not set
BR2_TARGET_UBIBOOT=y
BR2_TARGET_UBIBOOT_BOARDNAME="gcw0"
BR2_PACKAGE_HOST_GENIMAGE=y
```

## package/esoteric/Config.in
```kconfig
config BR2_PACKAGE_ESOTERIC
	bool "esoteric"
	select BR2_PACKAGE_DEJAVU
	select BR2_PACKAGE_LIBPNG
	select BR2_PACKAGE_SDL
	select BR2_PACKAGE_SDL_TTF
	help
	  Application menu for devices with a 320x240 screen and buttons.

	  This is a forked version with cleanups, targeted initially at the rg-350

	  https://github.com/podulator/esoteric
if BR2_PACKAGE_ESOTERIC

config BR2_PACKAGE_ESOTERIC_PLATFORM
	string "Target platform"

endif
```

## package/libshake2/Config.in
```kconfig
config BR2_PACKAGE_LIBSHAKE2
	bool "libshake2"
	help
	  A simple, cross-platform haptic library.

	  https://github.com/zear/libShake

if BR2_PACKAGE_LIBSHAKE2

config BR2_PACKAGE_LIBSHAKE2_PLATFORM
	string "Target platform"

endif
```
